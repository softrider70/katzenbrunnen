## sdkconfig.defaults
```kconfig
# Board-agnostic ESP-IDF configuration defaults
# These settings apply to all boards unless overridden in board-specific files

# ============================================================================
# Project Configuration
# ============================================================================
CONFIG_PROJECT_NAME="${PROJECT_NAME}"
CONFIG_PROJECT_VER="0.1.0"

# ============================================================================
# Application Stack & Task Configuration
# ============================================================================
CONFIG_APP_STACK_SIZE=4096
CONFIG_APP_PRIORITY=5
CONFIG_APP_LOGLEVEL=3

# ============================================================================
# FreeRTOS Configuration
# ============================================================================
CONFIG_FREERTOS_UNICORE=n
CONFIG_FREERTOS_RUN_TIME_STATS_USING_ESP_TIMER=y
CONFIG_FREERTOS_WATCHPOINT_END_OF_STACK=y

# ============================================================================
# Logging
# ============================================================================
CONFIG_LOG_DEFAULT_LEVEL=3
CONFIG_LOG_MAXIMUM_LEVEL=5
CONFIG_LOG_BOOTLOADER_LEVEL=3

# ============================================================================
# NVS (Non-Volatile Storage)
# ============================================================================
CONFIG_NVS_ENCRYPTION_KEY_SIZE=24

# ============================================================================
# Startup Configuration
# ============================================================================
CONFIG_ESP_CONSOLE_UART_NUM=0
CONFIG_ESP_CONSOLE_UART_BAUDRATE=115200

# ============================================================================
# Memory Configuration
# ============================================================================
CONFIG_SPIRAM_USE=y
CONFIG_SPIRAM_USE_MALLOC=y

# ============================================================================
# Security (Optional - uncomment for production)
# ============================================================================
# CONFIG_SECURE_BOOT_ENABLED=y
# CONFIG_SECURE_BOOT_V2_ENABLED=y
# CONFIG_SECURE_FLASH_ENC_ENABLED=y
```

## sdkconfig.defaults.esp32c3
```kconfig
# ESP32-C3 (Single-core RISC-V, 400KB SRAM)
# This file extends sdkconfig.defaults with ESP32-C3-specific settings

CONFIG_IDF_TARGET="esp32c3"

# ESP32-C3 is single-core RISC-V architecture
# CRITICAL: Must disable FreeRTOS core affinity for single-core systems
CONFIG_FREERTOS_UNICORE=y
CONFIG_FREERTOS_NO_AFFINITY=y

# C3-specific configuration
CONFIG_ESP32C3_DEFAULT_CPU_FREQ_160=y

# No PSRAM support on C3
CONFIG_SPIRAM_USE=n
```

## sdkconfig.defaults.esp32c6
```kconfig
# ESP32-C6 (Dual-core RISC-V, 512KB SRAM, PSRAM, Thread support)
# This file extends sdkconfig.defaults with ESP32-C6-specific settings

CONFIG_IDF_TARGET="esp32c6"

# ESP32-C6 has dual cores, no need for FREERTOS_NO_AFFINITY
CONFIG_FREERTOS_UNICORE=n

# C6 has built-in PSRAM (4MB typical)
CONFIG_SPIRAM=y
CONFIG_SPIRAM_MODE_QUAD=y
CONFIG_SPIRAM_USE=y

# C6-specific performance
CONFIG_ESP32C6_DEFAULT_CPU_FREQ_160=y

# Thread (OpenThread) support (optional)
# CONFIG_OPENTHREAD_ENABLED=y
```

## sdkconfig.defaults.esp32s2
```kconfig
# ESP32-S2 (Single-core RISC-V, 320KB SRAM)
# This file extends sdkconfig.defaults with ESP32-S2-specific settings

CONFIG_IDF_TARGET="esp32s2"

# ESP32-S2 is single-core RISC-V architecture
# CRITICAL: Must disable FreeRTOS core affinity for single-core systems
CONFIG_FREERTOS_UNICORE=y
CONFIG_FREERTOS_NO_AFFINITY=y

# S2-specific performance settings
CONFIG_ESP32S2_DEFAULT_CPU_FREQ_160=y

# PSRAM configuration (if available on your board)
# CONFIG_SPIRAM=y
# CONFIG_SPIRAM_MODE_QUAD=y
```
